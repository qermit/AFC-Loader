## Kconfig
```kconfig
#
# File system configuration
#
mainmenu "JAMMCI"

choice
	prompt "Microcontroler selection"

config MCU_LPC1769
	bool "LPC1769"
	select MCU_LPC176X

config MCU_LPC1764
	bool "LPC1764"
	select MCU_LPC176X

config MCU_ATXMEGA128A1U
	bool "ATxmega 128A1U"
	select CPU_AVRXMEGA7

endchoice


config MCU_LPC176X
	def_bool n
	select CPU_CORTEX_M3

config CPU_AVRXMEGA7
	def_bool n
	select ARCH_AVR

config CPU_CORTEX_M3
	def_bool n
	select ARCH_ARMV7_M

config ARCH_ARMV7_M
	def_bool n

config ARCH_AVR
	def_bool n

choice 
	prompt "Cross-compiler"
	default CROSS_COMPILE_ARM

config CROSS_COMPILE_ARM
	depends on CPU_CORTEX_M3
	bool "ARM None EABI"

config CROSS_COMPILE_AVR
	depends on ARCH_AVR
	bool "AVR"

config CROSS_COMPILE_CUSTOM
	bool "Custom value"

endchoice

config CROSS_COMPILE
	string "Custom cross-compiler prefix"
	depends on CROSS_COMPILE_CUSTOM

config CROSS_COMPILE_FIXED
	string 
	depends on !CROSS_COMPILE_CUSTOM
	default "arm-none-eabi-" if CROSS_COMPILE_ARM
	default "avr-" if CROSS_COMPILE_AVR



menu "Board selection"


config BOARD_AFC
	select FMC_COUNT_2
	def_bool n

config BOARD_AFC_V1
	select BOARD_AFC
	def_bool n

config BOARD_AFC_V2
	select BOARD_AFC
	def_bool n

config BOARD_AFC_V3
	select BOARD_AFC
	def_bool n

config BOARD_AFC_V3_1
	select BOARD_AFC
	def_bool n

config BOARD_AFCK
	select BOARD_AFC
	def_bool n

config BOARD_MATPEX
	select FMC_COUNT_0
	def_bool n

config BOARD_CUSTOM
	select FMC_COUNT_CUSTOM
	def_bool n


config BOARD_AUTODETECT_AFC_V1
        bool "AMC FMC CARRIER V1"
	depends on (DRIVER_HAL_BOARDAUTODETECT && (MCU_LPC176X || MCU_ATXMEGA128A1U))
	select BOARD_AFC_V1
        ---help---
        Select this option to use the format that corresponds to your GCC
        version.

config BOARD_AUTODETECT_AFC_V2
        bool "AMC FMC CARRIER V2"
	depends on (DRIVER_HAL_BOARDAUTODETECT && (MCU_LPC176X || MCU_ATXMEGA128A1U))
	select BOARD_AFC_V2
        ---help---
        Select this option to use the format that corresponds to your GCC
        version.

config BOARD_AUTODETECT_AFC_V3
        bool "AMC FMC CARRIER V3"
	depends on (DRIVER_HAL_BOARDAUTODETECT && (MCU_LPC176X || MCU_ATXMEGA128A1U))
	select BOARD_AFC_V3
        ---help---
        Select this option to use the format that corresponds to your GCC
        version.

config BOARD_AUTODETECT_AFC_V3_1
        bool "AMC FMC CARRIER v3.1"
	depends on (DRIVER_HAL_BOARDAUTODETECT && (MCU_LPC176X || MCU_ATXMEGA128A1U))
	select BOARD_AFC_V3_1
	---help---
	Select this option to use the format that corresponds to your GCC
	version.

config BOARD_AUTODETECT_AFCK
        bool "AMC FMC CARRIER KINTEX"
	depends on (DRIVER_HAL_BOARDAUTODETECT && (MCU_LPC176X || MCU_ATXMEGA128A1U))
	select BOARD_AFCK
        ---help---
        Select this option to use the format that corresponds to your GCC
        version.

config BOARD_AUTODETECT_MATPEX
	bool "MATPEX"
	select BOARD_MATPEX
	depends on (DRIVER_HAL_BOARDAUTODETECT && MCU_ATXMEGA128A1U)

config BOARD_AUTODETECT_CUSTOM
	bool "Custom board"
	select BOARD_CUSTOM
	depends on (DRIVER_HAL_BOARDAUTODETECT)


if (DRIVER_HAL_BOARDAUTODETECT=n)

choice  
	prompt "Fixed support"

config BOARD_FIXED_AFC_V1
        bool "AMC FMC CARRIER V1"
	depends on (MCU_LPC176X || MCU_ATXMEGA128A1U)
	select BOARD_AFC_V1
        ---help---
        Select this option to use the format that corresponds to your GCC
        version.

config BOARD_FIXED_AFC_V2
        bool "AMC FMC CARRIER V2"
	depends on (MCU_LPC176X || MCU_ATXMEGA128A1U)
	select BOARD_AFC_V2
        ---help---
        Select this option to use the format that corresponds to your GCC
        version.

config BOARD_FIXED_AFC_V3
        bool "AMC FMC CARRIER V3"
	depends on (MCU_LPC176X || MCU_ATXMEGA128A1U)
	select BOARD_AFC_V3
        ---help---
        Select this option to use the format that corresponds to your GCC
        version.

config BOARD_FIXED_AFC_V3_1
        bool "AMC FMC CARRIER v3.1"
	depends on (MCU_LPC176X || MCU_ATXMEGA128A1U)
	select BOARD_AFC_V3_1
        ---help---
        Select this option to use the format that corresponds to your GCC
        version.

config BOARD_FIXED_AFCK
        bool "AMC FMC CARRIER KINTEX"
	depends on (MCU_LPC176X || MCU_ATXMEGA128A1U)
	select BOARD_AFCK
        ---help---
        Select this option to use the format that corresponds to your GCC
        version.

config BOARD_FIXED_MATPEX
        bool "MATPEX"
	depends on (MCU_ATXMEGA128A1U)
	select BOARD_MATPEX
        ---help---
        Select this option to use the format that corresponds to your GCC
        version.

config BOARD_FIXED_CUSTOM
        bool "Custom board"
	select BOARD_CUSTOM
        ---help---
        Select this option to use the format that corresponds to your GCC
        version.

endchoice

endif


#endmenu

	
comment "Interconnections"

choice
	depends on BOARD_CUSTOM
	prompt "Custom fmc count"

config FMC_COUNT_CUSTOM_0
	bool "0"
	select FMC_COUNT_0

config FMC_COUNT_CUSTOM_1
	bool "1"
	select FMC_COUNT_1

config FMC_COUNT_CUSTOM_2
	bool "2"
	select FMC_COUNT_2

endchoice

config FMC_COUNT_0
	bool
	default true if FMC_COUNT_CUSTOM=0

config FMC_COUNT_1
	bool
	default true if FMC_COUNT_CUSTOM=1

config FMC_COUNT_2
	bool
	default true if FMC_COUNT_CUSTOM=2


config FMC_COUNT
	int
	default 2 if FMC_COUNT_2
	default 1 if FMC_COUNT_1
	default 0 if FMC_COUNT_0

if (FMC_COUNT > 0)
comment "FMC0"

config FMC0_USERCONFIG
	bool "Overite default FMC0 parameters"

config FMC0_VADJ_MIN
	depends on FMC0_USERCONFIG
	int "Minimal VADJ voltage"
	default 1800

config FMC0_VADJ_MAX
	depends on FMC0_USERCONFIG
	int "Maximal VADJ voltage"
	default 3300
endif

if (FMC_COUNT > 1)
comment "FMC1"

config FMC1_USERCONFIG
	bool "Overite default FMC0 parameters"

config FMC1_VADJ_MIN
	depends on FMC1_USERCONFIG
	int "Minimal VADJ voltage"
	default 1800

config FMC1_VADJ_MAX
	depends on FMC1_USERCONFIG
	int "Maximal VADJ voltage"
	default 3300


endif

endmenu




config ARCH
	string
	default "armv7-m" if ARCH_ARMV7_M
	default "atxmega" if ARCH_ATXMEGA

config CPU
	string
	default "cortex-m3" if CPU_CORTEX_M3
	default "atxmega" if CPU_AVRXMEGA7

config MCU
	string
	default "lpc1764" if MCU_LPC1764
	default "atxmega128a1u" if MCU_ATXMEGA128A1U


config FREERTOS
	bool "Use Freertos core"

choice
	prompt "Project type"

config PROJECT_EMMC
	select IPMI_IPMB
	bool "EMMC"

config PROJECT_MCH
	bool "MCH"

config PROJECT_STANDALONE
	bool "Standalone"

endchoice


config IPMI_IPMB
	bool "IPMB layer for IPMI"


source drivers/Kconfig

menu "Project"

source project/Kconfig

endmenu

config BOOTLOADER
	bool "Bootloader support"

choice
	prompt "Firmware update"
	default FW_UPDATE_NONE

config FW_UPDATE_NONE
	bool "No firmware update support"

config FW_UPDATE_INPLACE
	bool "in chip update"
	depends on BOOTLOADER
	---help---
	Generate one image.
	Firmware will be uploaded to second half of chip flash.
	Bootloader will copy firmware to lower half during startup.

config FW_UPDATE_INPLACE_DUAL
	bool "in chip update dual"
	depends on BOOTLOADER
	---help---
	Generate two images primary and secondary.
	New firmware will be uploaded to another half of mcu flash.
	Allows to have two versions of firmware.

config FW_UPDATE_SPI
	bool "SPI update"
	depends on (BOOTLOADER && DRIVER_HAL_SPI)
	---help---
	New firmware will be updated to external SPI flash.
	During boot time it will be burned into mcu flash.
	Allows to have multiple versions of firmware

endchoice
	
```

## drivers/Kconfig
```kconfig
menu Drivers

config DRIVER_HAL_BOARDAUTODETECT
	def_bool n

config DRIVER_HAL_I2C
	def_bool n

config DRIVER_HAL_SPI
	def_bool n

config DRIVER_HAL_GPIO
	def_bool n

config DRIVER_HAL_UART
	def_bool n

## specific drivers
## AVRXMEGA

config DRIVER_AVRXMEGA_GPIO
	bool "AVR xmega gpio driver"
	depends on MCU_AVRXMEGA
	select DRIVER_HAL_GPIO

config DRIVER_AVRXMEGA_I2C
	bool "AVR xmega I2C driver"
	depends on MCU_AVRXMEGA
	select DRIVER_HAL_I2C

config DRIVER_AVRXMEGA_SPI
	bool "AVR xmega SPI driver"
	depends on MCU_AVRXMEGA
	select DRIVER_HAL_SPI

## specific drivers
## LPC176X

config DRIVER_LPC176X_GPIO
	bool "LPC176X gpio driver"
	depends on MCU_LPC176X
	select DRIVER_HAL_GPIO

config DRIVER_LPC176X_I2C
	bool "LPC176X i2c driver"
	depends on MCU_LPC176X
	select DRIVER_HAL_I2C

config DRIVER_LPC176X_SPI
	bool "LPC176X spi driver"
	depends on MCU_LPC176X
	select DRIVER_HAL_SPI

config DRIVER_LPC176X_UART
	bool "LPC176X uart driver"
	depends on MCU_LPC176X
	select DRIVER_HAL_UART


config CHIP_I2C
	bool "I2C chips" if EXPERT
	default y if DRIVER_HAL_I2C
	default n if !DRIVER_HAL_I2C

config CHIP_I2C_MUX
	bool "I2C MUX"
	depends on CHIP_I2C

config CHIP_I2C_MCP79410
	bool "MCP79410 i2c RTCC"
	depends on CHIP_I2C

#submenu

config CHIP_I2C_MCP79410_BOARDDETECT
	bool "MCP79410 based board type detection"
	depends on CHIP_I2C_MCP79410
	select DRIVER_HAL_BOARDAUTODETECT

config CHIP_I2C_EEPROM
	bool "I2C Serial EEPROM"
	depends on CHIP_I2C

config CHIP_I2C_AT24
	bool "I2C AT24 mac"
	depends on CHIP_I2C

config CHIP_I2C_MAX6642
	bool "MAX6642 temperature sensor"
	depends on CHIP_I2C

config CHIP_I2C_LM75
	bool "LM75 temperature sensor"
	depends on CHIP_I2C

config CHIP_I2C_ADN4604
	bool "ADN4604 crossbar"
	depends on CHIP_I2C

config CHIP_I2C_SI57X
	bool "SI57X oscilator"
	depends on CHIP_I2C


config CHIP_I2C_INA220
	bool "INA220 current/power monitor"
	depends on CHIP_I2C


config DCHIP_I2C_TMP432A
	bool "TMP432A temperature sensor"
	depends on CHIP_I2C

config CHIP_I2C_WISHBONE
	bool "I2C wishbone driver"
	depends on CHIP_I2C

config CHIP_SPI
	bool "SPI Chips" if EXPERT
	default y if DRIVER_HAL_SPI
	default n if !DRIVER_HAL_SPI

config CHIP_SPI_FLASH
	bool "SPI flash" 
	depends on CHIP_SPI

config CHIP_SPI_AD8402
	bool "AD8402 DAC"
	depends on CHIP_SPI

config CHIP_SPI_WISHBONE
	bool "SPI wishbone driver"
	depends on CHIP_SPI


config WISHBONE
	bool "Wishbone bus"
	depends on (CHIP_SPI_WISHBONE || CHIP_I2C_WISHBONE)

config WISHBONE_SDB
	bool "Wishbone self describing bus"
	depends on WISHBONE

#endsubmenu

endmenu
```

## project/AFC-Diag/Kconfig
```kconfig
#
# Network configuration
#

config P_AFC_DIAG
	bool "AFC diagnostiscs"
	---help---
	  This project reads and writes diagnostic messages to FPGA
	  It is compatible with https://github.com/lnls-dig/bpm-gw
	  
```

## project/Kconfig
```kconfig
source project/TMS-Master/Kconfig
source project/TMS-Slave/Kconfig
source project/AFC-Diag/Kconfig
```

## project/TMS-Master/Kconfig
```kconfig
#
# Network configuration
#

menuconfig PROJECT_TMS_MASTER
	bool "TMS Master project"
	---help---
	  Unless you really know what you are doing, you should say Y here.
	  The reason is that some programs need kernel networking support even
	  when running on a stand-alone machine that isn't connected to any
	  other computer.
	  
if PROJECT_TMS_MASTER

config PROJECT_TMS_MASTER_BUILD_USERCODE
	bool "Usercode"
	help
	  This option can be selected by other options that need compat
	  netlink messages.

config PROJECT_TMS_MASTER_BUILD_FPGA
	bool "FPGA"
	help
	  This option can be selected by other options that need compat
	  netlink messages.


endif   # if PROJECT_TMS_MASTER
```

## project/TMS-Slave/Kconfig
```kconfig
#
# Network configuration
#

menuconfig PROJECT_TMS_SLAVE
	bool "TMS Slave project"
	---help---
	  Unless you really know what you are doing, you should say Y here.
	  The reason is that some programs need kernel networking support even
	  when running on a stand-alone machine that isn't connected to any
	  other computer.
	  
if PROJECT_TMS_SLAVE

config PROJECT_TMS_SLAVE_BUILD_USERCODE
	bool "Usercode"
	help
	  This option can be selected by other options that need compat
	  netlink messages.

config PROJECT_TMS_SLAVE_BUILD_FPGA
	bool "FPGA"
	help
	  This option can be selected by other options that need compat
	  netlink messages.


endif   # if PROJECT_TMS_SLAVE
```
